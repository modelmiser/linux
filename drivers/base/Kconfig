## drivers/base/Kconfig
```kconfig
# SPDX-License-Identifier: GPL-2.0
menu "Generic Driver Options"

config AUXILIARY_BUS
	bool

config UEVENT_HELPER
	bool "Support for uevent helper"
	help
	  The uevent helper program is forked by the kernel for
	  every uevent.
	  Before the switch to the netlink-based uevent source, this was
	  used to hook hotplug scripts into kernel device events. It
	  usually pointed to a shell script at /sbin/hotplug.
	  This should not be used today, because usual systems create
	  many events at bootup or device discovery in a very short time
	  frame. One forked process per event can create so many processes
	  that it creates a high system load, or on smaller systems
	  it is known to create out-of-memory situations during bootup.

config UEVENT_HELPER_PATH
	string "path to uevent helper"
	depends on UEVENT_HELPER
	default ""
	help
	  To disable user space helper program execution at by default
	  specify an empty string here. This setting can still be altered
	  via /proc/sys/kernel/hotplug or via /sys/kernel/uevent_helper
	  later at runtime.

config DEVTMPFS
	bool "Maintain a devtmpfs filesystem to mount at /dev"
	help
	  This creates a tmpfs/ramfs filesystem instance early at bootup.
	  In this filesystem, the kernel driver core maintains device
	  nodes with their default names and permissions for all
	  registered devices with an assigned major/minor number.
	  Userspace can modify the filesystem content as needed, add
	  symlinks, and apply needed permissions.
	  It provides a fully functional /dev directory, where usually
	  udev runs on top, managing permissions and adding meaningful
	  symlinks.
	  In very limited environments, it may provide a sufficient
	  functional /dev without any further help. It also allows simple
	  rescue systems, and reliably handles dynamic major/minor numbers.

	  Notice: if CONFIG_TMPFS isn't enabled, the simpler ramfs
	  file system will be used instead.

config DEVTMPFS_MOUNT
	bool "Automount devtmpfs at /dev, after the kernel mounted the rootfs"
	depends on DEVTMPFS
	help
	  This will instruct the kernel to automatically mount the
	  devtmpfs filesystem at /dev, directly after the kernel has
	  mounted the root filesystem. The behavior can be overridden
	  with the commandline parameter: devtmpfs.mount=0|1.
	  This option does not affect initramfs based booting, here
	  the devtmpfs filesystem always needs to be mounted manually
	  after the rootfs is mounted.
	  With this option enabled, it allows to bring up a system in
	  rescue mode with init=/bin/sh, even when the /dev directory
	  on the rootfs is completely empty.

config DEVTMPFS_SAFE
	bool "Use nosuid,noexec mount options on devtmpfs"
	depends on DEVTMPFS
	help
	  This instructs the kernel to include the MS_NOEXEC and MS_NOSUID mount
	  flags when mounting devtmpfs.

	  Notice: If enabled, things like /dev/mem cannot be mmapped
	  with the PROT_EXEC flag. This can break, for example, non-KMS
	  video drivers.

config DRIVER_DEFERRED_PROBE_TIMEOUT
	int "Default value for deferred_probe_timeout"
	default 0 if !MODULES
	default 10 if MODULES
	help
	  Set the default value for the deferred_probe_timeout kernel parameter.
	  See Documentation/admin-guide/kernel-parameters.txt for a description
	  of the deferred_probe_timeout kernel parameter.

config STANDALONE
	bool "Select only drivers that don't need compile-time external firmware"
	default y
	help
	  Select this option if you don't have magic firmware for drivers that
	  need it.

	  If unsure, say Y.

config PREVENT_FIRMWARE_BUILD
	bool "Disable drivers features which enable custom firmware building"
	default y
	help
	  Say yes to disable driver features which enable building a custom
	  driver firmware at kernel build time. These drivers do not use the
	  kernel firmware API to load firmware (CONFIG_FW_LOADER), instead they
	  use their own custom loading mechanism. The required firmware is
	  usually shipped with the driver, building the driver firmware
	  should only be needed if you have an updated firmware source.

	  Firmware should not be being built as part of kernel, these days
	  you should always prevent this and say Y here. There are only two
	  old drivers which enable building of its firmware at kernel build
	  time:

	    o CONFIG_WANXL through CONFIG_WANXL_BUILD_FIRMWARE
	    o CONFIG_SCSI_AIC79XX through CONFIG_AIC79XX_BUILD_FIRMWARE

source "drivers/base/firmware_loader/Kconfig"

config WANT_DEV_COREDUMP
	bool
	help
	  Drivers should "select" this option if they desire to use the
	  device coredump mechanism.

config ALLOW_DEV_COREDUMP
	bool "Allow device coredump" if EXPERT
	default y
	help
	  This option controls if the device coredump mechanism is available or
	  not; if disabled, the mechanism will be omitted even if drivers that
	  can use it are enabled.
	  Say 'N' for more sensitive systems or systems that don't want
	  to ever access the information to not have the code, nor keep any
	  data.

	  If unsure, say Y.

config DEV_COREDUMP
	bool
	default y if WANT_DEV_COREDUMP
	depends on ALLOW_DEV_COREDUMP

config DEBUG_DRIVER
	bool "Driver Core verbose debug messages"
	depends on DEBUG_KERNEL
	help
	  Say Y here if you want the Driver core to produce a bunch of
	  debug messages to the system log. Select this if you are having a
	  problem with the driver core and want to see more of what is
	  going on.

	  If you are unsure about this, say N here.

config DEBUG_DEVRES
	bool "Managed device resources verbose debug messages"
	depends on DEBUG_KERNEL
	help
	  This option enables kernel parameter devres.log. If set to
	  non-zero, devres debug messages are printed. Select this if
	  you are having a problem with devres or want to debug
	  resource management for a managed device. devres.log can be
	  switched on and off from sysfs node.

	  If you are unsure about this, Say N here.

config DEBUG_DEVRES_REFS
	bool "Warn about managed memory still held by open files at unbind"
	depends on DEBUG_KERNEL
	help
	  Before a driver's managed (devm) allocations are freed, on unbind
	  or after a failed probe, walk the open files of every thread and
	  WARN if one still points into an allocation about to be freed:
	  through file->private_data, the inode's i_private, the inode's
	  cdev for a character device, or an object a subsystem names
	  through a hook (V4L2 names the video_device). Such a pointer
	  dangles once the memory is freed; it is a use-after-free if
	  anything dereferences it afterwards: for private_data any
	  operation that uses it, for a cdev a new open of the device node
	  and its release on close, for a hook object whatever the
	  subsystem's operations do with it (for V4L2 any operation and
	  close), and for a debugfs file a new open or an unguarded
	  release. One WARN backtrace (which
	  taints the kernel) is printed per allocation per unbind; further
	  holders of the same allocation get one line each.

	  A removed debugfs file on which debugfs refuses further operations
	  (one created through its full proxy, or through one of its own
	  guarded helpers such as debugfs_create_ulong() or
	  debugfs_create_blob()) is reported at info level if its release
	  callback is one that cannot touch the data, and warned about
	  naming the callback otherwise. A debugfs file still live during
	  the walk is decided after the managed resources were released,
	  since drivers often remove their debugfs files through a devres
	  action: removed and safe to close by then is info, anything else
	  is a WARN. A file created with a debugfs _unsafe variant and the
	  driver's own file_operations gets no guard; it is deferred like a
	  live debugfs file and then warned about.

	  The walks run on a kernel thread, so a file reference the walk
	  turns out to hold last is released from the delayed-fput work and
	  never from the unbinding task, so a devres action that waits for
	  a file to close does not wait on the walk. What remains: that
	  work drains one global list last-in-first-out with all its runs
	  serialized, so a release there that needs a lock unbind holds (a
	  usbfs close takes the USB parent lock a USB interface unbind
	  holds) stalls every later delayed close, including one such an
	  action is waiting for; without this option that close would have
	  run from its owner's task work. No file reference is kept across
	  the release of the managed resources.

	  Limitations: only files in task fd tables are seen, so references
	  held by sockets, epoll, io_uring or kernel-internal files are not;
	  the check runs from the unbind and failed-probe paths only, not on
	  probe deferral nor on other devres release paths; a V4L2 driver's
	  state reached only through the video_device's drvdata is not
	  named, since that needs dereferencing the video_device; it finds
	  pointers
	  that are dangling at that moment, not teardown races, nor whether
	  a debugfs removal action ran before or after the free; a managed
	  allocation whose release waits for its files to close first (an
	  ALSA card) is not about to be freed, so a hit on it is a false
	  positive; a driver that keeps freeing devm memory after remove()
	  returned can make it misreport. The walk is linear in threads
	  times distinct fd tables and costs every unbind and failed probe.

	  This is a slow debug check intended for test systems.

	  If you are unsure about this, say N here.

config DEBUG_TEST_DRIVER_REMOVE
	bool "Test driver remove calls during probe (UNSTABLE)"
	depends on DEBUG_KERNEL
	help
	  Say Y here if you want the Driver core to test driver remove functions
	  by calling probe, remove, probe. This tests the remove path without
	  having to unbind the driver or unload the driver module.

	  This option is expected to find errors and may render your system
	  unusable. You should say N here unless you are explicitly looking to
	  test this functionality.

config PM_QOS_KUNIT_TEST
	bool "KUnit Test for PM QoS features" if !KUNIT_ALL_TESTS
	depends on KUNIT=y
	default KUNIT_ALL_TESTS

config PM_RUNTIME_KUNIT_TEST
	tristate "KUnit Tests for runtime PM" if !KUNIT_ALL_TESTS
	depends on KUNIT
	depends on PM
	default KUNIT_ALL_TESTS

config HMEM_REPORTING
	bool
	default n
	depends on NUMA
	help
	  Enable reporting for heterogeneous memory access attributes under
	  their non-uniform memory nodes.

source "drivers/base/test/Kconfig"

config SYS_HYPERVISOR
	bool
	default n

config GENERIC_CPU_DEVICES
	bool
	default n

config GENERIC_CPU_AUTOPROBE
	bool

config GENERIC_CPU_VULNERABILITIES
	bool

config SOC_BUS
	bool
	select GLOB

source "drivers/base/regmap/Kconfig"

config DMA_SHARED_BUFFER
	bool
	default n
	select IRQ_WORK
	help
	  This option enables the framework for buffer-sharing between
	  multiple drivers. A buffer is associated with a file using driver
	  APIs extension; the file's descriptor can then be passed on to other
	  driver.

config GENERIC_ARCH_TOPOLOGY
	bool
	help
	  Enable support for architectures common topology code: e.g., parsing
	  CPU capacity information from DT, usage of such information for
	  appropriate scaling, sysfs interface for reading capacity values at
	  runtime.

config FW_DEVLINK_SYNC_STATE_TIMEOUT
	bool "sync_state() behavior defaults to timeout instead of strict"
	help
	  This is build time equivalent of adding kernel command line parameter
	  "fw_devlink.sync_state=timeout". Give up waiting on consumers and
	  call sync_state() on any devices that haven't yet received their
	  sync_state() calls after deferred_probe_timeout has expired or by
	  late_initcall() if !CONFIG_MODULES. You should almost always want to
	  select N here unless you have already successfully tested with the
	  command line option on every system/board your kernel is expected to
	  work on.

endmenu
```

## drivers/base/test/Kconfig
```kconfig
# SPDX-License-Identifier: GPL-2.0
config TEST_ASYNC_DRIVER_PROBE
	tristate "Build kernel module to test asynchronous driver probing"
	depends on m
	help
	  Enabling this option produces a kernel module that allows
	  testing asynchronous driver probing by the device core.
	  The module name will be test_async_driver_probe.ko

	  If unsure say N.

config DM_KUNIT_TEST
	tristate "KUnit Tests for the device model" if !KUNIT_ALL_TESTS
	depends on KUNIT
	default KUNIT_ALL_TESTS

config DRIVER_PE_KUNIT_TEST
	tristate "KUnit Tests for property entry API" if !KUNIT_ALL_TESTS
	depends on KUNIT
	default KUNIT_ALL_TESTS

config DRIVER_SWNODE_KUNIT_TEST
	tristate "KUnit Tests for software node fw_devlink links" if !KUNIT_ALL_TESTS
	depends on KUNIT
	default KUNIT_ALL_TESTS

config DEVM_REFS_TEST
	tristate "Test driver for DEBUG_DEVRES_REFS"
	depends on DEBUG_DEVRES_REFS && DEBUG_FS
	help
	  Registers a platform device whose driver exposes /dev/devm_refs_bad
	  (state in devm memory, freed on unbind while open),
	  /dev/devm_refs_good (refcounted state), /dev/devm_refs_cdev (a
	  struct cdev embedded in devm memory) and a debugfs file bad_magic
	  whose data is that devm memory and whose removal is a devres
	  action. Unbinding with all four open must warn once for the bad
	  node and once for the cdev, and report the debugfs file at info
	  level after release. See drivers/base/test/devm_refs_test.c.

	  If unsure say N.
```
